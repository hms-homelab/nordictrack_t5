## main/Kconfig.projbuild
```kconfig
menu "Treadmill S3 Bridge"

    config TX_POWER_QDBM
        int "WiFi max TX power (quarter-dBm)"
        default 34
        range 8 84
        help
            Applied via esp_wifi_set_max_tx_power() after esp_wifi_start().
            Units are quarter-dBm (e.g. 34 = 8.5 dBm, 44 = 11 dBm, 84 = 21 dBm).

    config LED_GPIO
        int "Status LED GPIO"
        default 8
        help
            GPIO driving the status LED (SuperMini onboard LED is GPIO8).

    config FORCE_PROV_GPIO
        int "Force-provisioning GPIO (boot button)"
        default 0
        help
            Hold this GPIO low at boot to force PROV mode (clear config).
            GPIO0 is the SuperMini BOOT button.

    config POLL_INTERVAL_MS
        int "Telemetry poll/publish interval (ms)"
        default 200
        range 50 5000
        help
            How often treadmill telemetry is sampled and published to MQTT.

    config AP_SSID
        string "SoftAP SSID (PROV mode)"
        default "Treadmill-Setup"

    config AP_PASS
        string "SoftAP password (PROV mode, empty = open)"
        default ""

    config MQTT_TOPIC_PREFIX
        string "Default MQTT topic prefix"
        default "treadmill"
        help
            Base topic prefix for telemetry and Home Assistant discovery.
            May be overridden at runtime via provisioning.

endmenu
```

## sdkconfig.defaults
```kconfig
# ESP32-S3 Treadmill BLE-to-MQTT Bridge - Default Configuration

# Target
CONFIG_IDF_TARGET="esp32s3"

# Flash (SuperMini = 4MB)
CONFIG_ESPTOOLPY_FLASHSIZE_4MB=y
CONFIG_ESPTOOLPY_FLASHSIZE="4MB"

# Partition table
CONFIG_PARTITION_TABLE_CUSTOM=y
CONFIG_PARTITION_TABLE_CUSTOM_FILENAME="partitions.csv"

# Console over USB Serial/JTAG (S3 SuperMini native USB)
CONFIG_ESP_CONSOLE_USB_SERIAL_JTAG=y

# Main task stack (S3 hardening: >= 4096)
CONFIG_ESP_MAIN_TASK_STACK_SIZE=4096

# BLE (Bluedroid: GATTC for treadmill + GATTS for provisioning)
CONFIG_BT_ENABLED=y
CONFIG_BT_NIMBLE_ENABLED=n
CONFIG_BT_BLUEDROID_ENABLED=y
CONFIG_BT_BLE_ENABLED=y
CONFIG_BT_BLE_42_FEATURES_SUPPORTED=y
CONFIG_BTDM_CTRL_MODE_BLE_ONLY=y
CONFIG_BTDM_CTRL_MODE_BR_EDR_ONLY=n
CONFIG_BTDM_CTRL_MODE_BTDM=n
CONFIG_BT_GATTC_ENABLE=y
CONFIG_BT_GATTS_ENABLE=y
CONFIG_BT_BLE_SMP_ENABLE=n

# S3 HARDENING: default BTC task stack (3072) panics on S3 during service discovery
CONFIG_BT_BTC_TASK_STACK_SIZE=8192

# WiFi + BLE coexistence (mandatory for RUN mode)
CONFIG_SW_COEXIST_ENABLE=y

# HTTPS / TLS (OTA + MQTT TLS)
CONFIG_ESP_TLS_USING_MBEDTLS=y
CONFIG_MBEDTLS_CERTIFICATE_BUNDLE=y
CONFIG_MBEDTLS_CERTIFICATE_BUNDLE_DEFAULT_FULL=y
CONFIG_ESP_HTTP_CLIENT_ENABLE_HTTPS=y

# FreeRTOS
CONFIG_FREERTOS_HZ=1000
CONFIG_ESP_TASK_WDT_TIMEOUT_S=10

# mDNS hostname
CONFIG_LWIP_LOCAL_HOSTNAME="esp_treadmill"

# Logging
CONFIG_LOG_DEFAULT_LEVEL_INFO=y
CONFIG_LOG_MAXIMUM_LEVEL_VERBOSE=y
```
